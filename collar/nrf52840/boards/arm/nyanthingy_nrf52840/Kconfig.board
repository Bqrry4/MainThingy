## collar/nrf52840/boards/arm/nyanthingy_nrf52840/Kconfig.board
```kconfig
# Copyright (c) 2024 Nordic Semiconductor ASA
# SPDX-License-Identifier: Apache-2.0

config BOARD_NYANTHINGY_NRF52840
	bool "NyanThingy nrf52840"
	depends on SOC_NRF52840_QIAA
```

## collar/nrf52840_soc/boards/arm/nyanthingy_nrf52840/Kconfig.defconfig
```kconfig
# Copyright (c) 2024 Nordic Semiconductor ASA
# SPDX-License-Identifier: Apache-2.0

if BOARD_NYANTHINGY_NRF52840

config BOARD
	default "nyanthingy_nrf52840"

config BT_CTLR
   default BT


endif
```

## collar/nrf52840_soc/boards/arm/nyanthingy_nrf52840/nyanthingy_nrf52840_defconfig
```kconfig
# Copyright (c) 2024 Nordic Semiconductor ASA
# SPDX-License-Identifier: Apache-2.0

CONFIG_SOC_SERIES_NRF52X=y
CONFIG_SOC_NRF52840_QIAA=y
CONFIG_BOARD_NYANTHINGY_NRF52840=y

# Enable MPU
CONFIG_ARM_MPU=y

# Enable hardware stack protection
CONFIG_HW_STACK_PROTECTION=y

# Enable PINCTRL
CONFIG_PINCTRL=y

# enable uart driver
CONFIG_SERIAL=y

# Enable console
CONFIG_CONSOLE=y

CONFIG_BOOTLOADER_MCUBOOT=y
```

## collar/nrf52840_soc/src/ble_gatt/Kconfig
```kconfig
menu "Ble settings"

config BT_NUS_THREAD_STACK_SIZE
	int "Thread stack size"
	default 1024
	help
	  Stack size used of the ble_write_thread

config BT_NUS_THREAD_PRIORITY
	int "Thread prio"
	default 7

config BT_NUS_SECURITY_ENABLED
	bool "Enable security"
	default y
	select BT_SMP
	help
	  "Enable BLE security for the UART service"

config BT_NUS_SECURITY_PASSKEY
	int "Static passkey"
	default 228200

endmenu
module = BLE
module-str = ble
source "${ZEPHYR_BASE}/subsys/logging/Kconfig.template.log_config"
```

## collar/nrf52840_soc/src/uart_channel/Kconfig
```kconfig
menu "Lpuart settings"

config UART_BUFFER_SIZE
	int "UART payload buffer element size"
	default 64

config UART_RECEIVE_TIMEOUT
	int "Inactivity period after receiving at least a byte which triggers #UART_RX_RDY event"
	default 100
	help
	 In milisec

config UART_WAIT_FOR_BUFFER_DELAY
	int "The delay between the tries to allocate the rx buffer when malloc fails"
	default 50
	help
	 In milisec

config FIFO_TX_RETRANSMISSION_DELAY
	int "The delay between the tries to send the tx buffer when there is already an ongoing transfer"
	default 100
	help
	 In milisec

config UART_THREAD_STACK_SIZE
	int "Stack size for the uart tx thread"
	default 1024

config UART_THREAD_PRIORITY
	int "Priority of the uart tx thread"
	default 7


endmenu

module = LPUART
module-str = Lpuart
source "${ZEPHYR_BASE}/subsys/logging/Kconfig.template.log_config"
```

## collar/nrf52840_soc/src/watchdog/Kconfig
```kconfig
menuconfig ENABLE_WATCHDOG
	bool "Enable watchdog"
	select WATCHDOG

if ENABLE_WATCHDOG

config WATCHDOG_TIMEOUT
	int "Watchdog timeout in seconds"
	default 60

endif #ENABLE_WATCHDOG

module = WATCHDOG
module-str = watchdog
source "${ZEPHYR_BASE}/subsys/logging/Kconfig.template.log_config"
```

## collar/nrf9160/board/boards/arm/nyanthingy_nrf9160/Kconfig.board
```kconfig
# Copyright (c) 2024 Nordic Semiconductor ASA
# SPDX-License-Identifier: Apache-2.0

config BOARD_NYANTHINGY_NRF9160
	bool "NyanThingy nrf9160"
	depends on SOC_NRF9160_SICA
```

## collar/nrf9160/board/boards/arm/nyanthingy_nrf9160/Kconfig.defconfig
```kconfig
# Copyright (c) 2024 Nordic Semiconductor ASA
# SPDX-License-Identifier: Apache-2.0

if BOARD_NYANTHINGY_NRF9160

config BOARD
	default "nyanthingy_nrf9160"


#Build with TF-M as the Secure Execution Environment
config BUILD_WITH_TFM
	default y
endif
```

## collar/nrf9160/board/boards/arm/nyanthingy_nrf9160/nyanthingy_nrf9160_defconfig
```kconfig
# Copyright (c) 2024 Nordic Semiconductor ASA
# SPDX-License-Identifier: Apache-2.0

CONFIG_SOC_SERIES_NRF91X=y
CONFIG_SOC_NRF9160_SICA=y
CONFIG_BOARD_NYANTHINGY_NRF9160=y

# Enable MPU
CONFIG_ARM_MPU=y

# Enable hardware stack protection
CONFIG_HW_STACK_PROTECTION=y

# Enable TrustZone-M
CONFIG_ARM_TRUSTZONE_M=y

# This Board implies building Non-Secure firmware
CONFIG_TRUSTED_EXECUTION_NONSECURE=y
```

## collar/nrf9160/src/modem/Kconfig
```kconfig
menu "Lte settings"

config LTE_PSM_ENABLE
	bool "Enable LTE Power Saving Mode"
	default y

config LTE_EDRX_ENABLE
	bool "Enable LTE enhanced Discontinuous Reception"
	default y

config LTE_RAI_ENABLE
	bool "Enable LTE Release Assistance Indication"
endmenu

menu "GNSS settings"

config GNSS_PERIODIC_INTERVAL
	int "Fix interval for periodic GPS fixes"
	range 10 65535
	default 120
	help
	  Fix interval (in seconds) for periodic fixes.

config GNSS_PERIODIC_TIMEOUT
	int "Fix timeout for periodic GPS fixes"
	range 0 65535
	default 480
	help
	  Fix timeout (in seconds) for periodic fixes.
	  If set to zero, GNSS is allowed to run indefinitely until a valid PVT estimate is produced.

config GNSS_DYNAMICS_MODE
	int "The dynamics mode for improving positioning performance"
	range 0 3
	default 0
	help
		The dynamics mode can be changed without disruption in positioning.
		The selected dynamics mode is stored into the non-volatile memory.

		For the nrf9160 with the currently modem firmware version older(lower) than v2.0.0, all modes assuming maximum speed 100 km/h.
		Check the documentation for the newest stable sdk!!

endmenu

module = MODEM
module-str = Modem
source "${ZEPHYR_BASE}/subsys/logging/Kconfig.template.log_config"
```

## collar/nrf9160/src/modules/buzzer/Kconfig
```kconfig
menuconfig ENABLE_BUZZER
	bool "Enable buzzer"
	select PWM
	help
	  Buzzer with pwm

if ENABLE_BUZZER

config BUZZER_THREAD_STACK_SIZE
	int "Stack size for buzzer thread"
	default 1024

endif #ENABLE_BUZZER


module = BUZZER
module-str = buzzer
source "${ZEPHYR_BASE}/subsys/logging/Kconfig.template.log_config"
```

## collar/nrf9160/src/server_exchange/Kconfig
```kconfig
menu "Server identification"

config SERVER_HOSTNAME
	string "Server Hostname  or IP address"

config SERVER_PORT
	int "Server Port"
	default 5683
	default 5684 if OVER_DTLS

config COAP_OVER_DTLS
	bool "Use Coap over DTLS"
	select MODEM_KEY_MGMT

#Setting for when COAP_OVER_DTLS is enabled
config SOCK_SEC_TAG
	int "The sec_tag for the socket, which will connect to the server"
	default 12

config SOCK_PSK_IDENTITY
	string "The PSK identity"
	default "identity"

config SOCK_PSK_SECRET
	string "Server PSK in hex"
	default "736563726574"

endmenu

module = SERVER_EXCHANGE
module-str = Server Exchange
source "${ZEPHYR_BASE}/subsys/logging/Kconfig.template.log_config"
```

## collar/nrf9160/src/uart_channel/Kconfig
```kconfig
menu "Lpuart settings"

config UART_BUFFER_SIZE
	int "UART payload buffer element size"
	default 64

config UART_RECEIVE_TIMEOUT
	int "Inactivity period after receiving at least a byte which triggers #UART_RX_RDY event"
	default 100
	help
	 In milisec

config UART_WAIT_FOR_BUFFER_DELAY
	int "The delay between the tries to allocate the rx buffer when malloc fails"
	default 50
	help
	 In milisec

config FIFO_TX_RETRANSMISSION_DELAY
	int "The delay between the tries to send the tx buffer when there is already an ongoing transfer"
	default 100
	help
	 In milisec
	

endmenu

module = LPUART
module-str = Lpuart
source "${ZEPHYR_BASE}/subsys/logging/Kconfig.template.log_config"
```

## collar/nrf9160/src/uart_resolver/Kconfig
```kconfig
menu "Uart resolver settings"

config RESOLVER_THREAD_STACK_SIZE
	int "Stack size for the uart tx thread"
	default 1024

config RESOLVER_THREAD_PRIORITY
	int "Priority of the uart tx thread"
	default 7

endmenu

module = UART_RESOLVER
module-str = uart resolver
source "${ZEPHYR_BASE}/subsys/logging/Kconfig.template.log_config"
```
