## Kconfig
```
menu "MainThingy Settings"

config SERVER_HOSTNAME
	string "MainThingy server hostname or IP address"

config SERVER_PORT
	int "MainThingy server port number"
	default 5683
	default 5684 if OVER_DTLS

config UDP_DATA_UPLOAD_FREQUENCY_SECONDS
	int "How often data is transmitted to the server"
	default 900

config COAP_OVER_DTLS
	bool "Use Coap over DTLS"
	select MODEM_KEY_MGMT

config SOCK_SEC_TAG
	int "The sec_tag for the socket, which will connect to the server"
	default 12

config SOCK_PSK_IDENTITY
	string "The psk identity"
	default "identity"

config SOCK_PSK_SECRET
	string "Server PSK in hex"
	default "736563726574"

config USE_ASSISTANCE
	bool "Use assistance module"

config USE_ASSISTANCE_AGNSS
	bool "Use agnss assistance"
	select NRF_CLOUD_AGNSS
	
config USE_ASSISTANCE_PGPS
	bool "Use pgps assistance"
	select NRF_CLOUD_PGPS
	select FLASH
	select FLASH_MAP
	select STREAM_FLASH
	select FCB
	select DATE_TIME
endmenu


menu "Lte settings"

config LTE_PSM_ENABLE
	bool "Enable LTE Power Saving Mode"
	default y

config LTE_EDRX_ENABLE
	bool "Enable LTE enhanced Discontinuous Reception"
	default y

config LTE_RAI_ENABLE
	bool "Enable LTE Release Assistance Indication"
endmenu

menu "GNSS settings"

config GNSS_PERIODIC_INTERVAL
	int "Fix interval for periodic GPS fixes"
	range 10 65535
	default 120
	help
	  Fix interval (in seconds) for periodic fixes.

config GNSS_PERIODIC_TIMEOUT
	int "Fix timeout for periodic GPS fixes"
	range 0 65535
	default 480
	help
	  Fix timeout (in seconds) for periodic fixes.
	  If set to zero, GNSS is allowed to run indefinitely until a valid PVT estimate is produced.

config GNSS_DYNAMICS_MODE
	int "The dynamics mode for improving positioning performance"
	range 0 3
	default 0
	help
		The dynamics mode can be changed without disruption in positioning.
		The selected dynamics mode is stored into the non-volatile memory.

		For the nrf9160 with the currently modem firmware version older than v2.0.0, all modes assuming maximum speed 100 km/h.
		Check the documentation for the newest stable sdk!!

endmenu


menu "Server identification"

config SERVER_HOSTNAME
	string "Server_Hostname"
	default "californium.eclipseprojects.io"

config SERVER_PORT
	int "Server_Port"
	default 5683

endmenu

module = Main
module-str = MainThingy
source "${ZEPHYR_BASE}/subsys/logging/Kconfig.template.log_config"

menu "Zephyr Kernel"
source "Kconfig.zephyr"
endmenu
```

## prj.conf
```kconfig
## Logging
CONFIG_LOG=y
CONFIG_NRF_CLOUD_COAP_LOG_LEVEL_DBG=y
# CONFIG_LOG_MODE_IMMEDIATE=y

## General config
CONFIG_NEWLIB_LIBC=y
CONFIG_NEWLIB_LIBC_FLOAT_PRINTF=y
CONFIG_FPU=y
CONFIG_NCS_SAMPLES_DEFAULTS=y
CONFIG_SERIAL=n

## Network
CONFIG_NETWORKING=y
CONFIG_NET_SOCKETS=y
CONFIG_NET_SOCKETS_POSIX_NAMES=y
CONFIG_NET_SOCKETS_OFFLOAD=y
# Disable native network stack to save some memory
CONFIG_NET_NATIVE=n

## LTE link control
CONFIG_LTE_LINK_CONTROL=y

## Modem library
CONFIG_NRF_MODEM_LIB=y

## Heap and stacks
CONFIG_HEAP_MEM_POOL_SIZE=24576
CONFIG_MAIN_STACK_SIZE=4096
CONFIG_SYSTEM_WORKQUEUE_STACK_SIZE=9182

## LTE parameters
## Network Mode / LTE category
### Enable all of them
CONFIG_LTE_NETWORK_MODE_LTE_M_NBIOT_GPS=y

## PSM
CONFIG_LTE_PSM_ENABLE=y
CONFIG_LTE_PSM_REQ_RPTAU="00100001"
CONFIG_LTE_PSM_REQ_RAT="00000000"

## eDRX
CONFIG_LTE_EDRX_ENABLE=y
CONFIG_LTE_EDRX_REQ_VALUE_LTE_M="1001"

## RAI
CONFIG_LTE_RAI_ENABLE=n
CONFIG_LTE_RAI_REQ_VALUE="0"

##GNSS
CONFIG_GNSS_DYNAMICS_MODE=2
CONFIG_GNSS_PERIODIC_INTERVAL=240
CONFIG_GNSS_PERIODIC_TIMEOUT=120

## Server's
CONFIG_SERVER_HOSTNAME="138.2.150.47"
CONFIG_SERVER_PORT=34959
## Communication with the server
CONFIG_COAP=y
CONFIG_COAP_OVER_DTLS=y
CONFIG_SOCK_SEC_TAG=12
CONFIG_COAP_CLIENT_BLOCK_SIZE=1024
CONFIG_COAP_CLIENT_STACK_SIZE=6144
CONFIG_COAP_CLIENT_THREAD_PRIORITY=0
CONFIG_COAP_EXTENDED_OPTIONS_LEN_VALUE=32
CONFIG_ZCBOR=y

## Use Assistance
CONFIG_USE_ASSISTANCE=n
CONFIG_USE_ASSISTANCE_AGNSS=n
CONFIG_USE_ASSISTANCE_PGPS=n
# PGPS predictions, default equals one week
CONFIG_NRF_CLOUD_PGPS_NUM_PREDICTIONS=42
CONFIG_DOWNLOAD_CLIENT_MAX_HOSTNAME_SIZE=255
CONFIG_DOWNLOAD_CLIENT_MAX_FILENAME_SIZE=255
## Cloud assistance
CONFIG_NRF_CLOUD_COAP=y
CONFIG_MODEM_INFO=y
CONFIG_MODEM_JWT=y
CONFIG_MODEM_INFO_ADD_NETWORK=y
CONFIG_DATE_TIME=y
#CONFIG_JWT=y

##DEV ZOne
CONFIG_DK_LIBRARY=y
CONFIG_ZCBOR_VERBOSE=n
CONFIG_ZCBOR_CANONICAL=n

## RTT
CONFIG_USE_SEGGER_RTT=y
CONFIG_RTT_CONSOLE=y
CONFIG_UART_CONSOLE=n
```

## src/main.c
```c
#include <zephyr/kernel.h>
#include <modem/lte_lc.h>
#include <modem/nrf_modem_lib.h>

#include <zephyr/logging/log.h>

#include "modem_config.h"

#include <dk_buttons_and_leds.h>
#include <nrf_modem_at.h>
#include <zephyr/sys/timeutil.h>
#include <modem/modem_key_mgmt.h>


LOG_MODULE_REGISTER(MainThingy, LOG_LEVEL_INF);

// extern struct k_sem gnss_fix_sem;
// extern struct k_sem lte_connected_sem;

/// @return 0 on success, anything else otherwise
static int modem_configure(void)
{
        int err;

        err = nrf_modem_lib_init();
        if (err)
        {
                LOG_ERR("Modem library initialization failed, error: %d", err);
                return err;
        }

#if defined(CONFIG_COAP_OVER_DTLS)
        //Writing the pre-shared key to modem
        err = modem_key_mgmt_write(CONFIG_SOCK_SEC_TAG, MODEM_KEY_MGMT_CRED_TYPE_IDENTITY, CONFIG_SOCK_PSK_IDENTITY,
                                                                strlen(CONFIG_SOCK_PSK_IDENTITY));
        if (err) {
                LOG_ERR("Failed to write identity: %d\n", err);
                return err;
        }

        err = modem_key_mgmt_write(CONFIG_SOCK_SEC_TAG, MODEM_KEY_MGMT_CRED_TYPE_PSK, CONFIG_SOCK_PSK_SECRET,
                                                                strlen(CONFIG_SOCK_PSK_SECRET));
        if (err) {
                LOG_ERR("Failed to write identity: %d\n", err);
                return err;
        }
#endif /*CONFIG_COAP_OVER_DTLS*/

        err = lte_lc_init();
        if (err)
        {
                LOG_ERR("Modem LTE connection initialization failed, error: %d", err);
                return err;
        }

        err = lte_lc_offline();
        if (err)
        {
                LOG_ERR("Failed to start in OFFLINE functional mode");
                return err;
        }

        //This will activate LTE mode
        err = lte_init();
        if (err)
        {
                LOG_ERR("Failed to init LTE module, error: %d", err);
                return err;
        }
        
        wait_for_lte_connection(100);

        //This will start GNSS mode after the lte_init
        err = gnss_init();
        if (err)
        {
                LOG_ERR("Failed to init GNSS module, error: %d", err);
                return err;
        }

        return 0;
}

int main(void)
{
        int err;

        // FIXME:
        err = dk_leds_init();
        if (err)
        {
                LOG_ERR("Failed to initlize the LEDs Library");
        }

        LOG_INF("Starting app");

        if (modem_configure())
        {
                LOG_ERR("Failed on modem configuration");
                return -1;
        }
        
wait_for_lte_connection(100);

        mainThingy_init();
        send_gps_data();

       // k_sleep(K_SECONDS(300));



        

        //activate_gnss();

        // while (true)
        // {
        //         int err;
        //         int timezone;
        //         struct tm date_time;
        //         /* Read current UTC time from the modem. */
        //         err = nrf_modem_at_scanf("AT+CCLK?",
        // "+CCLK: \"%u/%u/%u,%u:%u:%u+%u\"",
        // 	&date_time.tm_year,
        // 	&date_time.tm_mon,
        // 	&date_time.tm_mday,
        // 	&date_time.tm_hour,
        // 	&date_time.tm_min,
        // 	&date_time.tm_sec,
        //         &timezone
        // );
        //             LOG_INF("+CCLK: \"%u/%u/%u,%u:%u:%u, %d , %u",
        // 	date_time.tm_year,
        // 	date_time.tm_mon,
        // 	date_time.tm_mday,
        // 	date_time.tm_hour,
        // 	date_time.tm_min,
        // 	date_time.tm_sec, err, timezone);
        //         k_sleep(K_MSEC(2000));
        //         // k_sem_take(&gnss_fix_sem, K_FOREVER);
        // }
        // k_work_schedule(&server_transmission_work, K_NO_WAIT);

        return 0;
}
```

## src/assistance.c
```c
#include <stdio.h>

#include <zephyr/logging/log.h>
#include <zephyr/sys/timeutil.h>
#include <nrf_modem_gnss.h>
#include <nrf_modem_at.h>
#include <net/nrf_cloud_coap.h>
#include <net/nrf_cloud_agnss.h>
#include <net/nrf_cloud_pgps.h>

#include "assistance.h"
#include "modem_config.h"

/* This module is using the nRfCloud Coap api assistance */

LOG_MODULE_REGISTER(assistance_module, LOG_LEVEL_INF);

#if defined(CONFIG_USE_ASSISTANCE_AGNSS)
static uint8_t agnss_buffer[4096];
#endif /* CONFIG_USE_ASSISTANCE_AGNSS */

#if defined(CONFIG_USE_ASSISTANCE_PGPS)

/// @brief Saving the agnss request, to inject it only with data from PGPS when AGNSS request to the cloud will fail
static struct nrf_modem_gnss_agnss_data_frame agnss_need;
static struct gps_pgps_request *pgps_request;
static struct nrf_cloud_pgps_prediction *prediction;

// The function for getting the pgps data
static void get_pgps_data_work_fn(struct k_work *work);
static struct k_work get_pgps_data_work;

// The function for injecting a pgps prediction
static void inject_pgps_data_work_fn(struct k_work *work);
static struct k_work inject_pgps_data_work;

// The pgps handler function
static void pgps_event_handler(struct nrf_cloud_pgps_event *event);
#endif /* CONFIG_USE_ASSISTANCE_PGPS */

// Reusing the working queue
static struct k_work_q *assistance_work_q;

int assistance_init(struct k_work_q *work_q)
{
    int err;

    __ASSERT(assistance_work_q != NULL,
             "null pointer assertion for parameter work_q");

    assistance_work_q = work_q;

    err = nrf_cloud_coap_init();
    if (err)
    {
        LOG_ERR("Failed to initialize nRF Cloud CoAP library.");
        return err;
    }

#if defined(CONFIG_USE_ASSISTANCE_PGPS)
    k_work_init(&get_pgps_data_work, get_pgps_data_work_fn);
    k_work_init(&inject_pgps_data_work, inject_pgps_data_work_fn);

    struct nrf_cloud_pgps_init_param pgps_param = {
        .event_handler = pgps_event_handler,
        /* storage is defined by CONFIG_NRF_CLOUD_PGPS_STORAGE */
        .storage_base = 0u,
        .storage_size = 0u};

    err = nrf_cloud_pgps_init(&pgps_param);
    if (err)
    {
        LOG_ERR("Failed to initialize P-GPS");
        return err;
    }
#endif /* CONFIG_USE_ASSISTANCE_PGPS */

    return 0;
}

#if defined(CONFIG_USE_ASSISTANCE_PGPS)
static void get_pgps_data_work_fn(struct k_work *work)
{
    ARG_UNUSED(work);

    int err;

    // Check for connection, and wait with a timeout of 1 min
    if (!wait_for_lte_connection(60))
    {
        LOG_ERR("Cannot proceed to request pgps assistance from nRfCloud as LTE is lacking connection");
        goto onFailure;
    }

    LOG_INF("Sending request for P-GPS predictions to nRF Cloud...");

    struct nrf_cloud_rest_pgps_request request = {
        .pgps_req = pgps_request};

    struct nrf_cloud_pgps_result file_location;

    err = nrf_cloud_coap_pgps_url_get(&request, &file_location);
    if (err)
    {
        LOG_ERR("Failed to retrieve the url for the PGPS, %d", err);
        goto onFailure;
    }

    LOG_INF("Processing P-GPS response");

    err = nrf_cloud_pgps_update(&file_location);
    if (err)
    {
        LOG_ERR("Failed to process binary P-GPS data using given url, %d", err);
        goto onFailure;
    }

    LOG_INF("P-GPS response processed");
    return;

onFailure:
    //re-enable future retries
    nrf_cloud_pgps_request_reset();
}

static void inject_pgps_data_work_fn(struct k_work *work)
{
    ARG_UNUSED(work);

    int err;

    LOG_INF("Injecting P-GPS ephemerides");

    err = nrf_cloud_pgps_inject(prediction, &agnss_need);
    if (err)
    {
        LOG_ERR("Failed to inject P-GPS ephemerides");
    }

    err = nrf_cloud_pgps_preemptive_updates();
    if (err)
    {
        LOG_ERR("Failed to request P-GPS updates");
    }
}

static void pgps_event_handler(struct nrf_cloud_pgps_event *event)
{
    switch (event->type)
    {
    case PGPS_EVT_AVAILABLE:
        prediction = event->prediction;

        k_work_submit_to_queue(assistance_work_q, &inject_pgps_data_work);
        break;

    case PGPS_EVT_REQUEST:
        // memcpy(&pgps_request, event->request, sizeof(pgps_request));
        pgps_request = event->request;

        k_work_submit_to_queue(assistance_work_q, &get_pgps_data_work);
        break;

    case PGPS_EVT_LOADING:
        LOG_INF("Loading P-GPS predictions");
        break;

    case PGPS_EVT_READY:
        LOG_INF("P-GPS predictions ready");
        break;

    default:
        break;
    }
}
#endif /* CONFIG_USE_ASSISTANCE_PGPS */

static int serving_cell_info_get(struct lte_lc_cell *serving_cell)
{
    int err;

    err = modem_info_init();
    if (err)
    {
        return err;
    }

    char resp_buf[MODEM_INFO_MAX_RESPONSE_SIZE];

    err = modem_info_string_get(MODEM_INFO_CELLID,
                                resp_buf,
                                MODEM_INFO_MAX_RESPONSE_SIZE);
    if (err < 0)
    {
        return err;
    }

    serving_cell->id = strtol(resp_buf, NULL, 16);

    err = modem_info_string_get(MODEM_INFO_AREA_CODE,
                                resp_buf,
                                MODEM_INFO_MAX_RESPONSE_SIZE);
    if (err < 0)
    {
        return err;
    }

    serving_cell->tac = strtol(resp_buf, NULL, 16);

    /* Request for MODEM_INFO_MNC returns both MNC and MCC in the same string. */
    err = modem_info_string_get(MODEM_INFO_OPERATOR,
                                resp_buf,
                                MODEM_INFO_MAX_RESPONSE_SIZE);
    if (err < 0)
    {
        return err;
    }

    serving_cell->mnc = strtol(&resp_buf[3], NULL, 10);
    /* Null-terminate MCC, read and store it. */
    resp_buf[3] = '\0';
    serving_cell->mcc = strtol(resp_buf, NULL, 10);

    return 0;
}

int assistance_request(struct nrf_modem_gnss_agnss_data_frame *agnss_request)
{

    int err = 0;

#if defined(CONFIG_USE_ASSISTANCE_PGPS)

    /* Store the agnss request for pgps use. */
    memcpy(&agnss_need, agnss_request, sizeof(agnss_need));

#if defined(CONFIG_USE_ASSISTANCE_AGNSS)
    if (!agnss_request->data_flags)
    {
        /* No assistance needed from A-GPS, skip directly to P-GPS. */
        nrf_cloud_pgps_notify_prediction();
        return 0;
    }

    // PGPS will handle ephemerides, so skip those.
    agnss_request->system->sv_mask_ephe = 0;
    // Almanacs are not needed with PGPS, so skip those.
    agnss_request->system->sv_mask_alm = 0;

#endif /* CONFIG_USE_ASSISTANCE_AGNSS */
#endif /* CONFIG_USE_ASSISTANCE_PGPS */

#if defined(CONFIG_USE_ASSISTANCE_AGNSS)
    // Check for connection, and wait with a timeout of 5 min
    if (!wait_for_lte_connection(300))
    {
        LOG_ERR("Cannot proceed to request agnss assistance from nRfCloud as LTE is lacking connection");
        goto agnss_exit;
    }

    err = nrf_cloud_coap_connect(NULL);
    if (err)
    {
        LOG_ERR("Failed to connect to nRfCloud through coAp, %d", err);
        goto agnss_exit;
    }

    struct nrf_cloud_rest_agnss_request request = {
        .type = NRF_CLOUD_REST_AGNSS_REQ_CUSTOM,
        .agnss_req = agnss_request,
        .net_info = NULL};

    struct nrf_cloud_rest_agnss_result result = {
        .buf = agnss_buffer,
        .buf_sz = sizeof(agnss_buffer)};

    struct lte_lc_cells_info net_info = {0};

    // Warning: Seems that it can crash the app if .net_info is NULL
    err = serving_cell_info_get(&net_info.current_cell);
    if (err)
    {
        LOG_ERR("Could not get cell info, error: %d", err);
        goto agnss_exit;
    }

    // Network info for the location request.
    request.net_info = &net_info;

    err = nrf_cloud_coap_agnss_data_get(&request, &result);
    if (err)
    {
        LOG_ERR("Failed to get agnss data, error %d", err);
        goto agnss_exit;
    }

    LOG_INF("Processing A-GNSS data");

    err = nrf_cloud_agnss_process(result.buf, result.agnss_sz);
    if (err)
    {
        LOG_ERR("Failed to process A-GNSS data, error: %d", err);
        goto agnss_exit;
    }

    LOG_INF("A-GNSS data injected");

agnss_exit:
#endif /* CONFIG_USE_ASSISTANCE_AGNSS */

#if defined(CONFIG_USE_ASSISTANCE_PGPS)
    nrf_cloud_pgps_notify_prediction();
#endif /* CONFIG_USE_ASSISTANCE_PGPS */

    return err;
}
```

## src/gnss.c
```c
#include <zephyr/kernel.h>
#include <nrf_modem_gnss.h>
#include <zephyr/logging/log.h>
#include <modem/lte_lc.h>

#include "modem_config.h"
#include "assistance.h"

LOG_MODULE_REGISTER(gnss_module, LOG_LEVEL_INF);

K_SEM_DEFINE(gnss_fix_sem, 0, 1);

#define GNSS_WORKQ_THREAD_STACK_SIZE 4096
#define GNSS_WORKQ_THREAD_PRIORITY 5

K_THREAD_STACK_DEFINE(gnss_workq_stack_area, GNSS_WORKQ_THREAD_STACK_SIZE);
static struct k_work_q gnss_work_q;

//::FIXME:
#include <dk_buttons_and_leds.h>

static struct nrf_modem_gnss_pvt_data_frame pvt_data;

static struct nrf_modem_gnss_agnss_data_frame agnss_data;
static struct k_work agnss_req_work;

static struct k_work lte_disable_work;

static void gnss_event_handler(int event_id);
static void print_fix_data(struct nrf_modem_gnss_pvt_data_frame *pvt_data);
static void agnss_req_work_fn(struct k_work *item);

int gnss_init()
{
    int err;

#if defined(CONFIG_USE_ASSISTANCE)

    err = assistance_init(&gnss_work_q);
    if (err)
    {
        LOG_ERR("Failed to init assistance module");
    }

    // Setting a work_queue
    struct k_work_queue_config cfg = {
        .name = "gnss_work_q",
        .no_yield = false};

    k_work_queue_start(
        &gnss_work_q,
        gnss_workq_stack_area,
        K_THREAD_STACK_SIZEOF(gnss_workq_stack_area),
        GNSS_WORKQ_THREAD_PRIORITY,
        &cfg);

    k_work_init(&agnss_req_work, agnss_req_work_fn);

#endif /*CONFIG_USE_ASSISTANCE*/

    if (nrf_modem_gnss_event_handler_set(gnss_event_handler))
    {
        LOG_ERR("Failed to set GNSS event handler");
        return -1;
    }

    // Using the periodic mode
    err = nrf_modem_gnss_fix_interval_set(CONFIG_GNSS_PERIODIC_INTERVAL);
    if (err)
    {
        LOG_ERR("Failed to set GNSS fix interval, error: %d", err);
        return err;
    }
    err = nrf_modem_gnss_fix_retry_set(CONFIG_GNSS_PERIODIC_TIMEOUT);
    if (err)
    {
        LOG_ERR("Failed to set GNSS fix retry, error: %d", err);
        return err;
    }

    // //FIXME: if assistance is disabled set to normal
        err = nrf_modem_gnss_use_case_set(NRF_MODEM_GNSS_USE_CASE_MULTIPLE_HOT_START | NRF_MODEM_GNSS_USE_CASE_LOW_ACCURACY | NRF_MODEM_GNSS_USE_CASE_SCHED_DOWNLOAD_DISABLE);
    if (err) {
    	LOG_WRN("Failed to set GNSS use case %d", err);
    }


    err = nrf_modem_gnss_start();
    if (err)
    {
        LOG_ERR("Failed to start GNSS, error: %d", err);
        return err;
    }

    err = nrf_modem_gnss_dyn_mode_change(CONFIG_GNSS_DYNAMICS_MODE);
    if (err)
    {
        LOG_ERR("Failed to set GNSS dynamics mode, error: %d", err);
        return err;
    }
    k_sleep(K_SECONDS(2));

    // nrf_modem_gnss_stop();

    // FIXME: need to fix about it
    //  err = nrf_modem_gnss_prio_mode_enable();
    //  if (err)
    //  {
    //      LOG_ERR("Error setting GNSS priority mode");
    //  }

    return 0;
}

int activate_gnss()
{
    LOG_INF("Enabling GNSS");

    int err = lte_lc_func_mode_set(LTE_LC_FUNC_MODE_ACTIVATE_GNSS);
    if (err)
    {
        LOG_ERR("Failed to activate GNSS functional mode");
        return err;
    }
    return 0;
}

int deactivate_gnss()
{
    LOG_INF("Disabling GNSS");

    int err = lte_lc_func_mode_set(LTE_LC_FUNC_MODE_DEACTIVATE_GNSS);
    if (err)
    {
        LOG_ERR("Failed to deactivate GNSS functional mode");
        return err;
    }
    return 0;
}

static void gnss_event_handler(int event_id)
{
    int err;

    LOG_INF("%d id", event_id);

    switch (event_id)
    {
    case NRF_MODEM_GNSS_EVT_PVT:
        // FIXME: Repair the function
        int num_satellites = 0;
        for (int i = 0; i < 12; i++)
        {
            if (pvt_data.sv[i].signal != 0)
            {
                //LOG_INF("sv: %d, cn0: %d", pvt_data.sv[i].sv, pvt_data.sv[i].cn0);
                num_satellites++;
            }
        }

        //LOG_INF("Number of current satellites: %d", num_satellites);

        if (nrf_modem_gnss_read(&pvt_data, sizeof(pvt_data), NRF_MODEM_GNSS_DATA_PVT))
        {
            LOG_ERR("nrf_modem_gnss_read failed, err %d", err);
            return;
        }

    LOG_INF("%d fags", pvt_data.flags);


        if (pvt_data.flags & NRF_MODEM_GNSS_PVT_FLAG_NOT_ENOUGH_WINDOW_TIME)
        {
            //LOG_INF("GNSS blocked by LTE");

            // err = k_work_submit(&lte_disable_work);
            // if(err < 0)
            // {
            //     LOG_ERR("failed to submit lte_disable_work, err %d", err);
            // }
        }

        if (pvt_data.flags & NRF_MODEM_GNSS_PVT_FLAG_LEAP_SECOND_VALID)
        {
            //LOG_INF("LEAP_SECOND_VALID");
        }

        //LOG_INF("flags %d", pvt_data.flags);

        if (pvt_data.flags & NRF_MODEM_GNSS_PVT_FLAG_FIX_VALID)
        {
            dk_set_led_on(DK_LED1);
            // dk_set_led_on(DK_LED1);
            print_fix_data(&pvt_data);
            /* STEP 12.3 - Print the time to first fix */
            if (true)
            {
                // LOG_INF("Time to first fix: %2.1lld s", (k_uptime_get() - gnss_start_time) / 1000);
            }
            return;
        }
        break;
    case NRF_MODEM_GNSS_EVT_PERIODIC_WAKEUP:
        LOG_INF("GNSS has woken up");
        dk_set_led_off(DK_LED2);
        dk_set_led_off(DK_LED1);
        dk_set_led_on(DK_LED3);

        break;
    case NRF_MODEM_GNSS_EVT_FIX:
        LOG_INF("GNSS recieved a fix");
        dk_set_led_on(DK_LED2);
        dk_set_led_off(DK_LED3);
        break;

    case NRF_MODEM_GNSS_EVT_SLEEP_AFTER_TIMEOUT:
        LOG_INF("GNSS sleep after timeout");
        dk_set_led_on(DK_LED2);
        dk_set_led_on(DK_LED1);
        dk_set_led_on(DK_LED3);
        dk_set_led_off(DK_LED3);

        break;

    // FIXME: bugged event
    case NRF_MODEM_GNSS_EVT_SLEEP_AFTER_FIX:
        LOG_INF("GNSS sleep after FIX");
        // dk_set_led_on(DK_LED3);
        // dk_set_led_off(DK_LED1);
        // k_sem_give(&gnss_fix_sem);

        break;

#if defined(CONFIG_USE_ASSISTANCE)
    case NRF_MODEM_GNSS_EVT_AGNSS_REQ:

        LOG_INF("AGNSS support requested");

        err = nrf_modem_gnss_read(&agnss_data, sizeof(agnss_data), NRF_MODEM_GNSS_DATA_AGNSS_REQ);
        if (err)
        {
            LOG_ERR("Failed to read agnss_req data, err %d", err);
            return;
        }

        // err = k_work_submit(&agnss_req_work);
        err = k_work_submit_to_queue(&gnss_work_q, &agnss_req_work);
        if (err < 0)
        {
            LOG_ERR("Failed to submit agnss_req_work to gnss_work_q, err %d", err);
            return;
        }
        break;
#endif /*CONFIG_USE_ASSISTANCE*/
    default:
        break;
    }
}

static void agnss_req_work_fn(struct k_work *item)
{
    ARG_UNUSED(item);

    int err;

    /* GPS data need is always expected to be present and first in list. */
    __ASSERT(agnss_data.system_count > 0,
             "GNSS system data need not found");
    __ASSERT(agnss_data.system[0].system_id == NRF_MODEM_GNSS_SYSTEM_GPS,
             "GPS data need not found");

    LOG_INF("Assistance data needed: data_flags: 0x%02x", agnss_data.data_flags);
    for (int i = 0; i < agnss_data.system_count; i++)
    {
        LOG_INF("Assistance data needed: %s ephe: 0x%llx, alm: 0x%llx",
                (agnss_data.system[i].system_id == NRF_MODEM_GNSS_SYSTEM_GPS)       ? "GPS"
                : (agnss_data.system[i].system_id == NRF_MODEM_GNSS_SYSTEM_QZSS)    ? "QZSS"
                : (agnss_data.system[i].system_id == NRF_MODEM_GNSS_SYSTEM_INVALID) ? "invalid"
                                                                                    : "unknown",
                agnss_data.system[i].sv_mask_ephe,
                agnss_data.system[i].sv_mask_alm);
    }

    err = assistance_request(&agnss_data);
    if (err)
    {
        LOG_ERR("Failed to request assistance data");
    }

    //Enabling gnss prio mode when needing additional data, which will be disabled after getting the fix
    err = nrf_modem_gnss_prio_mode_enable();
    if (err)
    {
        LOG_ERR("Error setting GNSS priority mode");
    }
    deactivate_lte();
}

//FIXME: needed only for debug
static void print_fix_data(struct nrf_modem_gnss_pvt_data_frame *pvt_data)
{
    LOG_INF("Latitude:       %.06f", pvt_data->latitude);
    LOG_INF("Longitude:      %.06f", pvt_data->longitude);
    LOG_INF("Altitude:       %.01f m", pvt_data->altitude);
    LOG_INF("Time (UTC):     %02u:%02u:%02u.%03u",
            pvt_data->datetime.hour,
            pvt_data->datetime.minute,
            pvt_data->datetime.seconds,
            pvt_data->datetime.ms);
}
```

## src/lte.c
```c
#include <modem/lte_lc.h>
#include <zephyr/logging/log.h>

#include "modem_config.h"

LOG_MODULE_REGISTER(lte_module, LOG_LEVEL_INF);

K_SEM_DEFINE(lte_connected_sem, 0, 1);

static bool is_connected = false;

static void lte_handler(const struct lte_lc_evt *const evt);
static void configure_low_power(void);

int lte_init()
{
    int err;

    configure_low_power();

    err = lte_lc_connect_async(lte_handler);
    if (err)
    {
        LOG_ERR("Connecting to LTE network failed, error: %d", err);
        return err;
    }

    return 0;
}

int activate_lte()
{
    LOG_INF("Enabling LTE");

    int err = lte_lc_func_mode_set(LTE_LC_FUNC_MODE_ACTIVATE_LTE);
    if (err)
    {
        LOG_ERR("Failed to activate LTE functional mode");
        return err;
    }

    enum lte_lc_func_mode mode;

    lte_lc_func_mode_get(&mode);
    LOG_INF("%d mode", mode);

    LOG_ERR("Semafor in");

    k_sem_take(&lte_connected_sem, K_FOREVER);

    // FIXME:
    /* Wait for a while, because with IPv4v6 PDN the IPv6 activation takes a bit more time. */
    k_sleep(K_SECONDS(1));

    LOG_INF("After semafor out");

    return 0;
}

int deactivate_lte()
{
    LOG_INF("Disabling LTE");

    int err = lte_lc_func_mode_set(LTE_LC_FUNC_MODE_DEACTIVATE_LTE);
    if (err)
    {
        LOG_ERR("Failed to deactivate LTE functional mode");
        return err;
    }

    is_connected = false;

    return 0;
}

bool wait_for_lte_connection(uint16_t seconds)
{
    for (int i = 0; i < seconds; ++i)
    {
        k_sleep(K_SECONDS(1));
        if (is_connected)
            break;
    }

    return is_connected;
}

static void lte_handler(const struct lte_lc_evt *const evt)
{
    switch (evt->type)
    {
    case LTE_LC_EVT_NW_REG_STATUS:
        if ((evt->nw_reg_status == LTE_LC_NW_REG_REGISTERED_HOME) ||
            (evt->nw_reg_status == LTE_LC_NW_REG_REGISTERED_ROAMING))
        {
            LOG_INF("Network registration status: %s",
                    evt->nw_reg_status == LTE_LC_NW_REG_REGISTERED_HOME ? "Connected - home network" : "Connected - roaming");
            is_connected = true;
            break;
        }
        is_connected = false;
        break;
    case LTE_LC_EVT_PSM_UPDATE:
        LOG_INF("PSM parameter update: TAU: %d, Active time: %d",
                evt->psm_cfg.tau, evt->psm_cfg.active_time);
        break;
    case LTE_LC_EVT_EDRX_UPDATE:
    {
        // char log_buf[60];
        // ssize_t len;

        // len = snprintf(log_buf, sizeof(log_buf),
        //                "eDRX parameter update: eDRX: %f, PTW: %f\n",
        //                evt->edrx_cfg.edrx, evt->edrx_cfg.ptw);
        // if (len > 0)
        // {
        //     LOG_INF("%s\n", log_buf);
        // }
        break;
    }
    case LTE_LC_EVT_RRC_UPDATE:
        LOG_INF("RRC mode: %s\n",
                evt->rrc_mode == LTE_LC_RRC_MODE_CONNECTED ? "Connected" : "Idle");
        break;
    case LTE_LC_EVT_CELL_UPDATE:
        LOG_INF("LTE cell changed: Cell ID: %d, Tracking area: %d",
                evt->cell.id, evt->cell.tac);
        break;
    default:
        break;
    }
}

static void configure_low_power(void)
{
    int err;

#if defined(CONFIG_LTE_PSM_ENABLE)
    /** Power Saving Mode */
    err = lte_lc_psm_req(true);
    if (err)
    {
        LOG_ERR("lte_lc_psm_req, error: %d", err);
    }
#else
    err = lte_lc_psm_req(false);
    if (err)
    {
        LOG_ERR("lte_lc_psm_req, error: %d", err);
    }
#endif

#if defined(CONFIG_LTE_EDRX_ENABLE)
    /** enhanced Discontinuous Reception */
    err = lte_lc_edrx_req(true);
    if (err)
    {
        LOG_ERR("lte_lc_edrx_req, error: %d", err);
    }
#else
    err = lte_lc_edrx_req(false);
    if (err)
    {
        LOG_ERR("lte_lc_edrx_req, error: %d", err);
    }
#endif

#if defined(CONFIG_LTE_RAI_ENABLE)
    /** Release Assistance Indication  */
    err = lte_lc_rai_req(true);
    if (err)
    {
        LOG_ERR("lte_lc_rai_req, error: %d", err);
    }
#endif
}
```

## src/mainThingy.c
```c
#include <zephyr/logging/log.h>

#include <zephyr/net/coap.h>
#include <zephyr/net/socket.h>
#include <nrfc_dtls.h>
#include <zephyr/net/tls_credentials.h>

#include <zephyr/random/rand32.h>
#include <zcbor_common.h>
#include <zcbor_encode.h>
#include <zcbor_decode.h>

LOG_MODULE_REGISTER(coAp_module, LOG_LEVEL_INF);

#define APP_COAP_VERSION 1

static int sock;
static struct sockaddr_storage server;

static uint16_t token;
static uint8_t coap_buf[1024];


/// @brief Resolve the server's hostname
/// @return 0 on succes, <0 otherwise
static int server_resolve(void);

int mainThingy_init()
{
    int err;

    err = server_resolve();
    if (err)
    {
        LOG_ERR("Failed to resolve the server's hostname : %d\n", err);
        return err;
    }

//Creating a socket for connection with main server
#if defined(CONFIG_COAP_OVER_DTLS)
    LOG_DBG("DTLS enabled");

	sock = socket(AF_INET, SOCK_DGRAM, IPPROTO_DTLS_1_2);
	LOG_DBG("sock = %d", sock);
	if (sock < 0) {
		LOG_ERR("Failed to create CoAP socket: %d.", -errno);
		return -errno;
	}

    //Setting as in nrfc_dtlc.c, but with relevant parameters
    LOG_DBG("Setting socket options:");

	LOG_DBG("  hostname: %s", CONFIG_SERVER_HOSTNAME);
	err = setsockopt(sock, SOL_TLS, TLS_HOSTNAME, CONFIG_SERVER_HOSTNAME,
			 sizeof(CONFIG_SERVER_HOSTNAME));
	if (err) {
		LOG_ERR("Error setting hostname: %d", -errno);
		return -errno;
	}

    sec_tag_t sec_tag = CONFIG_SOCK_SEC_TAG;
	LOG_DBG("  sectag: %d", sec_tag);
	err = setsockopt(sock, SOL_TLS, TLS_SEC_TAG_LIST, &sec_tag, sizeof(sec_tag));
	if (err) {
		LOG_ERR("Failed to setup socket security tag: %d", -errno);
		return -errno;
	}

	int cid_option = TLS_DTLS_CID_SUPPORTED;

	LOG_DBG("  Enable connection id");
	err = setsockopt(sock, SOL_TLS, TLS_DTLS_CID, &cid_option, sizeof(cid_option));
	if (!err) {
		LOG_INF("Connection ID enabled");
	} else if ((err != EOPNOTSUPP) && (err != EINVAL)) {
		LOG_ERR("Error enabling connection ID: %d", -errno);
	} else {
		LOG_INF("Connection ID not supported by the provided socket");
	}

	int timeout = TLS_DTLS_HANDSHAKE_TIMEO_123S;

	LOG_DBG("  Set handshake timeout %d", timeout);
	err = setsockopt(sock, SOL_TLS, TLS_DTLS_HANDSHAKE_TIMEO,
			 &timeout, sizeof(timeout));
	if (!err) {
	} else if ((err != EOPNOTSUPP) || (err != EINVAL)) {
		LOG_ERR("Error setting handshake timeout: %d", -errno);
	}

	int verify = TLS_PEER_VERIFY_REQUIRED;

	LOG_DBG("  Peer verify: %d", verify);
	err = setsockopt(sock, SOL_TLS, TLS_PEER_VERIFY, &verify, sizeof(verify));
	if (err) {
		LOG_ERR("Failed to setup peer verification, errno %d", -errno);
		return -errno;
	}

	int session_cache = TLS_SESSION_CACHE_ENABLED;

	err = setsockopt(sock, SOL_TLS, TLS_SESSION_CACHE, &session_cache, sizeof(session_cache));
	if (err) {
		LOG_ERR("Failed to enable session cache, errno: %d", -errno);
    	return -errno;
	}

#else
    sock = socket(AF_INET, SOCK_DGRAM, IPPROTO_UDP);
    if (sock < 0)
    {
        LOG_ERR("Failed to create socket: %d.\n", errno);
        return -errno;
    }
#endif /*CONFIG_COAP_OVER_DTLS*/

    err = connect(sock, (struct sockaddr *)&server,
                  sizeof(struct sockaddr_in));
    if (err < 0)
    {
        LOG_ERR("Connect failed : %d\n", errno);
        return -errno;
    }

    // Randomize token.
    token = sys_rand32_get();

    return 0;
}

static int server_resolve(void)
{
    int err;
    struct addrinfo *result;
    struct addrinfo hints = {
        .ai_family = AF_INET,
        .ai_socktype = SOCK_DGRAM};
    char ipv4_addr[NET_IPV4_ADDR_LEN];

    err = getaddrinfo(CONFIG_SERVER_HOSTNAME, NULL, &hints, &result);
    if (err)
    {
        LOG_ERR("ERROR: getaddrinfo failed %d\n", err);
        return err;
    }

    /* IPv4 Address. */
    struct sockaddr_in *server4 = ((struct sockaddr_in *)&server);

    server4->sin_addr.s_addr =
        ((struct sockaddr_in *)result->ai_addr)->sin_addr.s_addr;
    server4->sin_family = AF_INET;
    server4->sin_port = htons(CONFIG_SERVER_PORT);

    // Convert network address from internal to numeric ASCII form
    err = inet_ntop(AF_INET, &server4->sin_addr.s_addr, ipv4_addr,
                    sizeof(ipv4_addr));
    if (err == NULL)
    {
        LOG_ERR("Failed to get the string representation of address \
        from it internal representation: %d.\n",
                errno);
        return -errno;
    }

    LOG_INF("IPv4 Address found %s\n", ipv4_addr);

    /* Free the address. */
    freeaddrinfo(result);

    return 0;
}

int send_gps_data(void)
{
    int err;

    struct coap_packet request;
    uint8_t payload[128] = {0};

    ZCBOR_STATE_E(encoding_state, 0, payload, sizeof(payload), 0);
    err = zcbor_map_start_encode(encoding_state, 0) &&
          zcbor_tstr_put_lit(encoding_state, "lon") &&
          zcbor_float64_put(encoding_state, 2.2) &&
          zcbor_tstr_put_lit(encoding_state, "lat") &&
          zcbor_float64_put(encoding_state, 2.3) &&
          zcbor_tstr_put_lit(encoding_state, "acr") &&
          zcbor_float32_put(encoding_state, 2.4) &&
          zcbor_map_end_encode(encoding_state, 0);
    if (!err)
    {
        err = zcbor_peek_error(encoding_state);
        LOG_ERR("Encoding failed: %d", err);
        return -err;
    }

    // As the pointer in encoding state is incrementing a it goes, we can find the size of the final encoded content as follows
    int payload_len = encoding_state->payload - payload;
    // If this will fail in future releases of the zcbor library, try with strlen and send the size of buffer - 1, or check for a function

    token++;

    err = coap_packet_init(&request, coap_buf, sizeof(coap_buf),
                           APP_COAP_VERSION, COAP_TYPE_NON_CON,
                           sizeof(token), (uint8_t *)&token,
                           COAP_METHOD_POST, coap_next_id());
    if (err < 0)
    {
        LOG_ERR("Failed to create CoAP request, %d", err);
        return err;
    }

    err = coap_packet_append_option(&request, COAP_OPTION_URI_PATH,
                                    (uint8_t *)"loc", 3);
    if (err < 0)
    {
        LOG_ERR("Failed to encode CoAP path option, %d", err);
        return err;
    }

    err = coap_packet_append_payload_marker(&request);
    if (err < 0)
    {
        LOG_ERR("Failed to append the payload marker, %d", err);
        return err;
    }

    err = coap_packet_append_payload(&request, (uint8_t *)payload,
                                     payload_len);
    if (err)
    {
        LOG_ERR("Failed to add the payload, %d", err);
        return err;
    }

    err = send(sock, request.data, request.offset, 0);
    if (err < 0)
    {
        LOG_ERR("Failed to send CoAP request, %d, %d", errno, err);
        return -errno;
    }

    LOG_INF("CoAP request sent to /loc resource: token 0x%04x, bytes sent: %d", token, err);

    return 0;
}
```

## src/mainThingy.h
```c
#ifndef MODEM_CONFIG_H
#define MODEM_CONFIG_H

int mainThingy_init();
/// @brief Seng gps data in CBOR format to the PUT: /gps route on the server
int send_gps_data(void);
#endif
```

## src/modem_config.h
```c
#ifndef MODEM_CONFIG_H
#define MODEM_CONFIG_H

/// @brief Init lte
/// @return 0 on success, anything else otherwise
int lte_init();
/// @brief  Init and start GNSS
/// @return 0 on success, anything else otherwise
int gnss_init();
/// @brief Enable LTE
/// @return 0 on success, failed otherwise
int activate_lte();
/// @brief Disable LTE
/// @return 0 on success, failed otherwise
int deactivate_lte();
/// @brief Enable GNSS
/// @return 0 on success, failed otherwise
int activate_gnss();
/// @brief Disable GNSS
/// @return 0 on success, failed otherwise
int deactivate_gnss();

/// @brief Checks for current lte connection status and get blocked till Timeout
/// @param seconds Timeout in seconds
/// @return lte connection status
bool wait_for_lte_connection(uint16_t seconds);

#endif
```
