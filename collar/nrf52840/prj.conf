## CMakeLists.txt
```
cmake_minimum_required(VERSION 3.20.0)
find_package(Zephyr REQUIRED HINTS $ENV{ZEPHYR_BASE})

project(NRF52840)

# Entry point
target_sources(app PRIVATE src/main.c)

# App headers
zephyr_library_include_directories(
  src/events
  src/uart_channel
  src/ble_gatt
  src/imu_classifier
  src/watchdog
  src/uart_resolver
  )

# App directories
add_subdirectory(src/events)
add_subdirectory(src/uart_channel)
add_subdirectory(src/ble_gatt)
add_subdirectory(src/imu_classifier)
add_subdirectory(src/uart_resolver)
add_subdirectory_ifdef(CONFIG_ENABLE_WATCHDOG src/watchdog)
```

## prj.conf
```kconfig
# General
CONFIG_HEAP_MEM_POOL_SIZE=8192
CONFIG_SYSTEM_WORKQUEUE_STACK_SIZE=4096
CONFIG_MAIN_STACK_SIZE=2048

# Logging
CONFIG_LOG=y
CONFIG_LOG_DEFAULT_LEVEL=2
CONFIG_FPU=y
CONFIG_USE_SEGGER_RTT=y
CONFIG_LOG_BACKEND_RTT=y
CONFIG_LOG_BACKEND_RTT_MODE_DROP=y

#Low power UART using the async api
CONFIG_NRF_SW_LPUART=y
CONFIG_UART_1_NRF_ASYNC_LOW_POWER=y
# CONFIG_UART_ASYNC_API=y
CONFIG_UART_1_ASYNC=y
CONFIG_UART_1_INTERRUPT_DRIVEN=n
CONFIG_UART_1_NRF_HW_ASYNC=y
CONFIG_UART_1_NRF_HW_ASYNC_TIMER=2
CONFIG_NRFX_TIMER2=y

#BLe Peripheral -- The main role
CONFIG_BT=y
CONFIG_BT_PERIPHERAL=y
CONFIG_BT_DEVICE_NAME="NyanThingy"
CONFIG_BT_PERIPHERAL_PREF_MIN_INT=800
CONFIG_BT_PERIPHERAL_PREF_MAX_INT=800
CONFIG_BT_PERIPHERAL_PREF_LATENCY=0
CONFIG_BT_PERIPHERAL_PREF_TIMEOUT=400
CONFIG_BT_GAP_AUTO_UPDATE_CONN_PARAMS=y
CONFIG_BT_USER_PHY_UPDATE=y

# The NUS bt service
CONFIG_BT_NUS=y
CONFIG_BT_NUS_SECURITY_ENABLED=y
CONFIG_BT_NUS_AUTHEN=y

CONFIG_BT_FIXED_PASSKEY=y
CONFIG_BT_NUS_SECURITY_PASSKEY=228200
# Bonding
CONFIG_SETTINGS=y
CONFIG_BT_SETTINGS=y
CONFIG_FLASH=y
CONFIG_FLASH_PAGE_LAYOUT=y
CONFIG_FLASH_MAP=y
CONFIG_NVS=y
CONFIG_BT_MAX_CONN=2
CONFIG_BT_MAX_PAIRED=2    
CONFIG_BT_KEYS_OVERWRITE_OLDEST=y

#Central for IMU
CONFIG_BT_CENTRAL=y
CONFIG_BT_SCAN=y
CONFIG_BT_SCAN_FILTER_ENABLE=y
# CONFIG_BT_SCAN_UUID_CNT=1
CONFIG_BT_SCAN_NAME_CNT=1
CONFIG_BT_GATT_CLIENT=y
CONFIG_BT_GATT_DM=y


# Enable events
CONFIG_APP_EVENT_MANAGER=y
```

## src/main.c
```c
#include <zephyr/logging/log.h>
#include <app_event_manager.h>

#include "uart_channel/uart_channel.h"
#include "ble_gatt/ble.h"
#include "imu_classifier.h"

LOG_MODULE_REGISTER(MainThingy, LOG_LEVEL_INF);

int main()
{
    int err;

    err = app_event_manager_init();
    if (err)
    {
        LOG_ERR("Unable to init Application Event Manager (%d)", err);
        return err;
    }

    err = ble_init();
    if (err)
    {
        LOG_ERR("Failed to init ble module, %d", err);
        return err;
    }

    err = uart_channel_init();
    if (err)
    {
        LOG_ERR("Failed to init uart_channel module, %d", err);
        return err;
    }

    // should be initiated when ble is enabled
    err = imu_classifier_init();
    if (err)
    {
        LOG_ERR("Failed to init imu_classifier module, %d", err);
        return err;
    }

    LOG_INF("Started");

    return 0;
}
```
